## config/boards/shields/corne/Kconfig.defconfig
```kconfig
if SHIELD_CORNE_LEFT

config ZMK_KEYBOARD_NAME
    default "Jkb"

config ZMK_SPLIT_ROLE_CENTRAL
    default y

endif

if SHIELD_JKB_LEFT || SHIELD_JKB_RIGHT

config ZMK_SPLIT
    default y
endif
```

## config/boards/shields/corne/Kconfig.shield
```kconfig
config SHIELD_JKB_LEFT
    def_bool $(shields_list_contains, jkb_left)

config SHIELD_JKB_RIGHT
    def_bool $(shields_list_contains, jkb_right)
```
