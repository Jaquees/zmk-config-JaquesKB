## boards/shields/jaqueskb/Kconfig.shield
```kconfig
config SHIELD_JAQUESKB_LEFT
    def_bool $(shields_list_contains,jaqueskb_left)


config SHIELD_JAQUESKB_RIGHT
    def_bool $(shields_list_contains,jaqueskb_right)
```

## boards/shields/jaqueskb/kconfig.defconfig
```kconfig
if SHIELD_JAQUESKB_LEFT

# Name must be less than 16 characters long!
config ZMK_KEYBOARD_NAME
    default "jaqueskb"

config ZMK_SPLIT_ROLE_CENTRAL
    default y

endif

if SHIELD_JAQUESKB_LEFT || SHIELD_JAQUESKB_RIGHT

config ZMK_SPLIT
    default y

endif
```

## boards/shields/jaqueskb/kconfig.shield
```kconfig
# No whitespace after the comma or in your part name!
config SHIELD_JAQUESKB_LEFT
    def_bool $(shields_list_contains,jaqueskb_left)

# No whitespace after the comma or in your part name!
config SHIELD_JAQUESKB_RIGHT
    def_bool $(shields_list_contains,jaqueskb_right)
```

## config/west.yml
```yaml
manifest:
  defaults:
    revision: main 
  remotes:
    - name: zmkfirmware
      url-base: https://github.com/zmkfirmware
    - name: zmk-config-JaquesKB
      url-base: https://github.com/Jaquees/zmk-config-JaquesKB
    # Additional modules containing boards/shields/custom code can be listed here as well
    # See https://docs.zephyrproject.org/3.2.0/develop/west/manifest.html#projects
  projects:
    - name: zmk
      remote: zmkfirmware
      import: app/west.yml
    - name: zmk-config-JaquesKB
      remote: zmk-config-JaquesKB
      revision: main
  self:
    path: config
```
